## CMakeLists.txt
```
# SPDX-License-Identifier: Apache-2.0
cmake_minimum_required(VERSION 3.20.0)
find_package(Zephyr REQUIRED HINTS $ENV{ZEPHYR_BASE})
project(simple_http_server)
target_sources(app PRIVATE src/main.c)

zephyr_linker_sources(SECTIONS sections-rom.ld)
zephyr_linker_section(
    NAME http_resource_desc_test_http_service
    KVMA RAM_REGION GROUP RODATA_REGION
)

# Define where the generated files will go
set(gen_dir ${ZEPHYR_BINARY_DIR}/include/generated/)

# Generate the gzipped header file
generate_inc_file_for_target(app
    src/static_web_resources/index.html
    ${gen_dir}/index.html.gz.inc
    --gzip
)

# Tell the compiler where to find the generated file
target_include_directories(app PRIVATE ${gen_dir})
```

## prj.conf
```kconfig
# # General Stack & OS
# CONFIG_MAIN_STACK_SIZE=4096
# CONFIG_SYSTEM_WORKQUEUE_STACK_SIZE=2048

# CONFIG_INIT_STACKS=y
# CONFIG_ZVFS_POLL_MAX=32

# CONFIG_POSIX_API=y

# # Network buffers
# CONFIG_NET_PKT_RX_COUNT=16
# CONFIG_NET_PKT_TX_COUNT=16
# CONFIG_NET_BUF_RX_COUNT=128
# CONFIG_NET_BUF_TX_COUNT=128
# CONFIG_NET_CONTEXT_NET_PKT_POOL=y

# # Networking Core
# CONFIG_NETWORKING=y
# CONFIG_NET_IPV4=y
# CONFIG_NET_TCP=y
# CONFIG_NET_MAX_CONTEXTS=10
# CONFIG_NET_MAX_CONN=10

# # HTTP Server
# CONFIG_HTTP_SERVER=y


# # Static IP Configuration
# CONFIG_NET_CONFIG_SETTINGS=y
# CONFIG_NET_CONFIG_NEED_IPV4=y
# CONFIG_NET_CONFIG_MY_IPV4_ADDR="192.168.0.50"
# CONFIG_NET_CONFIG_MY_IPV4_NETMASK="255.255.255.0"
# CONFIG_NET_CONFIG_MY_IPV4_GW="192.168.0.1"

# # Logging (Keep this for debugging)
# CONFIG_LOG=y
# CONFIG_NET_LOG=y

# # Device drivers
# CONFIG_GPIO=y
# CONFIG_LED=y

# # JSON
# CONFIG_JSON_LIBRARY=y
# General config
CONFIG_MAIN_STACK_SIZE=3072
CONFIG_SYSTEM_WORKQUEUE_STACK_SIZE=2048
CONFIG_SHELL=y
CONFIG_LOG=y
CONFIG_ENTROPY_GENERATOR=y
CONFIG_TEST_RANDOM_GENERATOR=y
CONFIG_INIT_STACKS=y
CONFIG_POSIX_API=y
CONFIG_ZVFS_POLL_MAX=32

# Eventfd
CONFIG_EVENTFD=y

# Networking config
CONFIG_NETWORKING=y
CONFIG_NET_IPV4=y
CONFIG_NET_IPV6=y
CONFIG_NET_TCP=y
CONFIG_NET_SOCKETS=y
CONFIG_NET_CONNECTION_MANAGER=y
CONFIG_NET_SHELL=y
CONFIG_NET_STATISTICS=y
CONFIG_NET_STATISTICS_USER_API=y
CONFIG_NET_LOG=y

# JSON
CONFIG_JSON_LIBRARY=y

# HTTP parser
CONFIG_HTTP_PARSER_URL=y
CONFIG_HTTP_PARSER=y
CONFIG_HTTP_SERVER=y
CONFIG_HTTP_SERVER_WEBSOCKET=y

# Network buffers
CONFIG_NET_PKT_RX_COUNT=16
CONFIG_NET_PKT_TX_COUNT=16
CONFIG_NET_BUF_RX_COUNT=128
CONFIG_NET_BUF_TX_COUNT=128
CONFIG_NET_CONTEXT_NET_PKT_POOL=y

# IP address options
CONFIG_NET_IF_UNICAST_IPV6_ADDR_COUNT=3
CONFIG_NET_IF_MCAST_IPV6_ADDR_COUNT=4
CONFIG_NET_MAX_CONTEXTS=32
CONFIG_NET_MAX_CONN=32

# Network address config
CONFIG_NET_CONFIG_SETTINGS=y
CONFIG_NET_CONFIG_NEED_IPV4=y
CONFIG_NET_CONFIG_NEED_IPV6=y
CONFIG_NET_CONFIG_MY_IPV4_ADDR="192.168.1.50"
CONFIG_NET_CONFIG_PEER_IPV4_ADDR="192.168.1.50"
CONFIG_NET_CONFIG_MY_IPV4_GW="192.168.1.1"
CONFIG_NET_CONFIG_MY_IPV6_ADDR="2001:db8::1"
CONFIG_NET_CONFIG_PEER_IPV6_ADDR="2001:db8::2"

# Networking tweaks
# Required to handle large number of consecutive connections,
# e.g. when testing with ApacheBench.
CONFIG_NET_TCP_TIME_WAIT_DELAY=0

# Device drivers
CONFIG_GPIO=y
CONFIG_LED=y

# Network debug config
CONFIG_NET_SOCKETS_LOG_LEVEL_DBG=n
CONFIG_NET_HTTP_LOG_LEVEL_DBG=n
CONFIG_NET_IPV6_LOG_LEVEL_DBG=n
CONFIG_NET_IPV6_ND_LOG_LEVEL_DBG=n
```

## src/main.c
```c
// #include <zephyr/kernel.h>
// #include <zephyr/logging/log.h>
// #include <zephyr/net/socket.h>

// LOG_MODULE_REGISTER(http_raw);

// #define PORT 8080

// void main(void)
// {
//     int sock, client;
//     struct sockaddr_in addr;

//     LOG_INF("Starting raw HTTP server on port %d", PORT);

//     sock = zsock_socket(AF_INET, SOCK_STREAM, IPPROTO_TCP);
//     if (sock < 0) {
//         LOG_ERR("Socket failed: %d", errno);
//         return;
//     }

//     addr.sin_family = AF_INET;
//     addr.sin_port = htons(PORT);
//     addr.sin_addr.s_addr = INADDR_ANY;

//     if (zsock_bind(sock, (struct sockaddr *)&addr, sizeof(addr)) < 0) {
//         LOG_ERR("Bind failed");
//         return;
//     }

//     zsock_listen(sock, 1);

//     while (1) {
//         client = zsock_accept(sock, NULL, NULL);
//         if (client >= 0) {
//             const char *response = "HTTP/1.1 200 OK\r\nContent-Type: text/html\r\n\r\n"
//                                    "<html><body><h1>Hello from raw HTTP!</h1></body></html>";
//             zsock_send(client, response, strlen(response), 0);
//             zsock_close(client);
//         }
//     }
// }
#include <zephyr/kernel.h>
#include <zephyr/net/http/server.h>
#include <zephyr/net/http/service.h>
#include <zephyr/logging/log.h>
#include <zephyr/data/json.h>
#include <zephyr/drivers/led.h>


LOG_MODULE_REGISTER(simple_server, LOG_LEVEL_DBG);
static uint16_t ui_port = 80;

static const uint8_t index_html[] = {
#include "index.html.gz.inc"
};

struct switch_command {
	int switch_num;
	int switch_val;
};

static const struct device *leds_dev = DEVICE_DT_GET_ANY(gpio_leds);

static const struct json_obj_descr switch_command_descr[] = {
	JSON_OBJ_DESCR_PRIM(struct switch_command, switch_num, JSON_TOK_NUMBER),
	JSON_OBJ_DESCR_PRIM(struct switch_command, switch_val, JSON_TOK_NUMBER),
};

static void parse_switch_post(uint8_t *buf, size_t len)
{
	int ret;
	struct switch_command cmd;
	const int expected_return_code = BIT_MASK(ARRAY_SIZE(switch_command_descr));

	ret = json_obj_parse(buf, len, switch_command_descr, ARRAY_SIZE(switch_command_descr), &cmd);
	k_free(buf);
	if (ret != expected_return_code) {
		LOG_WRN("Failed to fully parse JSON payload, ret=%d", ret);
		return;
	}

	LOG_INF("POST request setting Switch %d to state %d", cmd.switch_num, cmd.switch_val);

	if (leds_dev != NULL) {
		if (cmd.switch_val) {
			led_on(leds_dev, cmd.switch_num);
		} else {
			led_off(leds_dev, cmd.switch_num);
		}
	}
}

static int switch_handler(struct http_client_ctx *client, enum http_data_status status,
		       const struct http_request_ctx *request_ctx,
		       struct http_response_ctx *response_ctx, void *user_data)
{
	static uint16_t buffer_size = 128;
	uint8_t *post_payload_buf = k_malloc(buffer_size);
	static size_t cursor;

	LOG_DBG("Switch handler status %d, size %zu", status, request_ctx->data_len);

	if (status == HTTP_SERVER_DATA_ABORTED) {
		cursor = 0;
		k_free(post_payload_buf);
		return 0;
	}

	if (request_ctx->data_len + cursor > buffer_size) {
		cursor = 0;
		LOG_ERR("Size of the message is to long, please increase the buffer size\n");
		k_free(post_payload_buf);
		return -ENOMEM;
	}

	/* Copy payload to our buffer. Note that even for a small payload, it may arrive split into
	 * chunks (e.g. if the header size was such that the whole HTTP request exceeds the size of
	 * the client buffer).
	 */
	memcpy(post_payload_buf + cursor, request_ctx->data, request_ctx->data_len);
	cursor += request_ctx->data_len;

	if (status == HTTP_SERVER_DATA_FINAL) {
		parse_switch_post(post_payload_buf, cursor);
		cursor = 0;
	}

	return 0;
}

static struct http_resource_detail_static index_detail = {
    .common = {
        .type = HTTP_RESOURCE_TYPE_STATIC,
        .bitmask_of_supported_http_methods = BIT(HTTP_GET),
        .content_encoding = "gzip",
        .content_type = "text/html",
    },
    .static_data = index_html,
    .static_data_len = sizeof(index_html),
};

static struct http_resource_detail_dynamic switch_resource_detail = {
	.common = {
			.type = HTTP_RESOURCE_TYPE_DYNAMIC,
			.bitmask_of_supported_http_methods = BIT(HTTP_POST),
		},
	.cb = switch_handler,
	.user_data = NULL,
};

HTTP_SERVICE_DEFINE(test_http_service, NULL, &ui_port, 1, 10, NULL, NULL, NULL);

HTTP_RESOURCE_DEFINE(index_res, test_http_service, "/", &index_detail);

HTTP_RESOURCE_DEFINE(switch_res, test_http_service, "/led", &switch_resource_detail);

int main(void)
{
    // k_sleep(K_MSEC(2000));
    // led_on(leds_dev, 0);
    // k_sleep(K_MSEC(2000));
    // led_off(leds_dev, 0);
    // k_sleep(K_MSEC(2000));
    int err = http_server_start();
    if (err) {
        LOG_ERR("Server failed: %d", err);
    }
    return 0;
}
```
