## CMakeLists.txt
```
cmake_minimum_required(VERSION 3.20.0)
find_package(Zephyr REQUIRED HINTS $ENV{ZEPHYR_BASE})
project(WebSmartHome)

target_sources(app PRIVATE
    src/main.c
    src/Room.c
    src/Web.c
    src/Schedule.c
)

zephyr_linker_sources(SECTIONS sections-rom.ld)
zephyr_linker_section(
    NAME http_resource_desc_test_http_service
    KVMA RAM_REGION GROUP RODATA_REGION
)

# Define where the generated files will go
set(gen_dir ${ZEPHYR_BINARY_DIR}/include/generated/)

# Generate the gzipped header file
generate_inc_file_for_target(app
    src/static_web_resources/index.html
    ${gen_dir}/index.html.gz.inc
    --gzip
)

# Tell the compiler where to find the generated file
target_include_directories(app PRIVATE
    ${CMAKE_CURRENT_SOURCE_DIR}/include
    ${gen_dir}
)
```

## west.yml
```
manifest:
  self:
    path: app

  remotes:
    - name: zephyrproject-rtos
      url-base: https://github.com/zephyrproject-rtos

  projects:
    - name: zephyr
      remote: zephyrproject-rtos
      revision: v3.6.0
      clone-depth: 1
      import:
        name-allowlist:
          - cmsis_6
          - hal_adi
          - hal_nxp
          - hal_stm32
          - picolibc
```

## prj.conf
```kconfig
# ==============================================================================
# SYSTEM & CORE
# ==============================================================================
CONFIG_PRINTK=y
CONFIG_MAIN_STACK_SIZE=3072
CONFIG_SYSTEM_WORKQUEUE_STACK_SIZE=2048
CONFIG_INIT_STACKS=y

# ==============================================================================
# MEMORY & HEAP
# ==============================================================================
CONFIG_HEAP_MEM_POOL_SIZE=4096
CONFIG_SYS_HEAP_RUNTIME_STATS=y

# ==============================================================================
# DEBUGGING & LOGGING
# ==============================================================================
CONFIG_SHELL=y
CONFIG_LOG=y
CONFIG_ENTROPY_GENERATOR=y
CONFIG_TEST_RANDOM_GENERATOR=y

# ==============================================================================
# HARDWARE PERIPHERALS
# ==============================================================================
CONFIG_GPIO=y
CONFIG_LED=y
CONFIG_PWM=y
CONFIG_PWM_STM32=y

# Sensors
CONFIG_SENSOR=y
CONFIG_SENSOR_ASYNC_API=y
CONFIG_DHT=y

# ==============================================================================
# POSIX & SYSTEM APIs
# ==============================================================================
CONFIG_POSIX_API=y
CONFIG_ZVFS_POLL_MAX=32
CONFIG_EVENTFD=y

# ==============================================================================
# NETWORKING - CORE
# ==============================================================================
CONFIG_NETWORKING=y
CONFIG_NET_IPV4=y
CONFIG_NET_IPV6=y
CONFIG_NET_TCP=y
CONFIG_NET_SOCKETS=y
CONFIG_NET_CONNECTION_MANAGER=y

# ==============================================================================
# NETWORKING - BUFFERS & RESOURCES
# ==============================================================================
CONFIG_NET_PKT_RX_COUNT=16
CONFIG_NET_PKT_TX_COUNT=16
CONFIG_NET_BUF_RX_COUNT=128
CONFIG_NET_BUF_TX_COUNT=128
CONFIG_NET_CONTEXT_NET_PKT_POOL=y

# Contexts and connections
CONFIG_NET_IF_UNICAST_IPV6_ADDR_COUNT=3
CONFIG_NET_IF_MCAST_IPV6_ADDR_COUNT=4
CONFIG_NET_MAX_CONTEXTS=32
CONFIG_NET_MAX_CONN=32

# ==============================================================================
# NETWORKING - PROTOCOLS
# ==============================================================================
# HTTP Server
CONFIG_HTTP_PARSER=y
CONFIG_HTTP_PARSER_URL=y
CONFIG_HTTP_SERVER=y
CONFIG_HTTP_SERVER_MAX_CLIENTS=4

# WebSocket
CONFIG_HTTP_SERVER_WEBSOCKET=y
CONFIG_WEBSOCKET_MAX_CONTEXTS=4

# ==============================================================================
# NETWORKING - CONFIGURATION
# ==============================================================================
CONFIG_NET_CONFIG_SETTINGS=y
CONFIG_NET_CONFIG_NEED_IPV4=y
CONFIG_NET_CONFIG_NEED_IPV6=y

# IPv4 Static Configuration
CONFIG_NET_CONFIG_MY_IPV4_ADDR="192.168.1.50"
CONFIG_NET_CONFIG_PEER_IPV4_ADDR="192.168.1.50"
CONFIG_NET_CONFIG_MY_IPV4_GW="192.168.1.1"

# IPv6 Static Configuration
CONFIG_NET_CONFIG_MY_IPV6_ADDR="2001:db8::1"
CONFIG_NET_CONFIG_PEER_IPV6_ADDR="2001:db8::2"

# ==============================================================================
# NETWORKING - OPTIMIZATION
# ==============================================================================
# Required to handle large number of consecutive connections (e.g., ApacheBench)
CONFIG_NET_TCP_TIME_WAIT_DELAY=0

# ==============================================================================
# NETWORKING - DEBUG & MONITORING
# ==============================================================================
CONFIG_NET_SHELL=y
CONFIG_NET_STATISTICS=y
CONFIG_NET_STATISTICS_USER_API=y
CONFIG_NET_LOG=y

# Debug log levels (set to 'n' to reduce verbosity)
CONFIG_NET_SOCKETS_LOG_LEVEL_DBG=n
CONFIG_NET_HTTP_LOG_LEVEL_DBG=n
CONFIG_NET_IPV6_LOG_LEVEL_DBG=n
CONFIG_NET_IPV6_ND_LOG_LEVEL_DBG=n

# ==============================================================================
# TIME & RTC
# ==============================================================================
CONFIG_RTC=y
CONFIG_SNTP=y

# ==============================================================================
# JSON LIBRARY
# ==============================================================================
CONFIG_JSON_LIBRARY=y

# ==============================================================================
# MISCELLANEOUS
# ==============================================================================
CONFIG_REBOOT=y
```

## include/Room.h
```c
#ifndef ROOMS_H
#define ROOMS_H

#include <zephyr/kernel.h>
#include <zephyr/device.h>
#include <zephyr/drivers/gpio.h>
#include <zephyr/drivers/pwm.h>
#include <zephyr/logging/log.h>
#include <stddef.h>
#include <string.h>

#include <zephyr/drivers/sensor.h>
#include <zephyr/drivers/sensor_data_types.h>

#include "config.h"
#include "Schedule.h"

extern struct k_fifo events_fifo;
extern struct k_fifo web_events_fifo;

enum {
    ROOM_LED_POWER,
    ROOM_LED_INFO,
    ROOM_LED_ERROR,
    ROOM_LED_COUNT
};

enum {
    LIVINROOM_ROOM,
    KITCHEN_ROOM,
    STRUCT_ROOM_COUNT
};

enum VALUE_TYPE {
    SWITCH_EV,
    LIGHT_EV,
    HEAT_EV,
    HUM_EV,
    SETPOINT_EV,
    HEAT_RELAY_EV,
    SCHEDULE_ADDED_EV,
    COUNT_EV,
    NONE_EV
};

typedef void (*event_action_t)(void *ctx, uint32_t value);

struct Event {
    void *fifo_reserved;
    event_action_t action;
    void *ctx;
    uint32_t value;
};

struct WebEvent {
    void *fifo_reserved;
    int room_id;
    enum VALUE_TYPE value_type;
    union {
        uint32_t value;
        struct Schedule *sched;
    } data;
};

struct Room {
    void* fifo_reserved;

    const uint8_t room_id;
    const char* room_name;

/* Light */
    /* Switch can toggle pwm device or gpio*/
    const struct gpio_dt_spec* light_switch;   // INPUT
    const struct pwm_dt_spec* light_pwm;       // OUTPUT PWM
    const struct gpio_dt_spec* light_gpio;     // OUTPUT GPIO
    uint32_t light_gpio_value;                 // Current GPIO value

/* Heat */
    /* Sensor and RTIO IODEV for DHT22 */
    const struct device *const dht_devices;    // INPUT DHT device
    struct rtio_iodev *const dht_iodevs;       // RTIO IODEV for DHT
    const struct device *const temp_dht11;     // INPUT Temperature sensor device
    uint32_t temp_sensor_value;                // Last read temperature
    uint32_t hum_sensor_value;                 // Last read humidity
    /* Actuators */
    const struct gpio_dt_spec* heat_relay;     // OUTPUT HEAT relay GPIO
    bool heat_relay_state;                     // OUTPUT HEAT relay state
    uint32_t desired_temperature;              // Desired temperature

    uint32_t offset_desired_temperature;       // Offset for desired temperature
                                               // VALUES: 25  - 0.25 C
                                               //         50  - 0.50 C
                                               //         75  - 0.75 C
                                               //         100 - 1.00 C

    struct Schedule list_of_schedules[MAX_SCHEDULES_PER_ROOM];
    uint8_t no_sched;

    struct k_mutex lock;
};

void gpio_event_action(void *ctx, uint32_t value);

void pwm_event_action(void *ctx, uint32_t value);

bool room_device_init();

struct Room** get_all_rooms();

struct Room* get_room_by_id(int id);

const struct gpio_dt_spec* get_led_by_id(int id);

int register_new_event(struct Room *room, uint32_t new_value, enum VALUE_TYPE event_type, bool is_for_web_event);

int read_temp_and_hum(struct Room *room, uint32_t* temp_fit, uint32_t* hum_fit);

int read_temp_and_hum_dht11(struct Room *room, uint32_t* temp_scaled, uint32_t* hum_scaled);

bool register_new_web_event(uint32_t room_id, enum VALUE_TYPE value_type, void* value);

int register_new_event_complex(struct Room *room, void* new_data, enum VALUE_TYPE event_type, bool is_for_web_event);

void process_temperature_control(struct Room *room);

void process_light_control(struct Room *room, uint32_t new_light_gpio_value);

#endif
```

## include/Schedule.h
```c
#ifndef SCHEDULE_H
#define SCHEDULE_H

#include <time.h>
#include <zephyr/drivers/rtc.h>
#include <zephyr/net/sntp.h>
#include <zephyr/net/socket.h>

extern struct k_sem new_data_sem;

struct Room;

enum SCHED_TYPE {
    SETPOINT_SCH,
    LIGHT_SCH
};

struct Schedule {
    int time; // seconds from midnight
    int value;
    enum SCHED_TYPE type;
    struct Room *parent_room;
};

void sync_rtc_with_network();

uint32_t get_seconds_today_from_rtc(void);

// Schedule

struct Schedule* get_next_schedule();

uint32_t calculate_time_for_schedule(struct Schedule* schedule);

int addNewSchedule(struct Schedule schedule);

int removeSchedule(struct Schedule schedule);

uint32_t to_seconds_today(struct rtc_time time);

void execute_schedule(struct Schedule *schedule);

#endif
```

## include/config.h
```c
#ifndef CONFIG_H
#define CONFIG_H

#define DEBUG_MODE

#define MAX_ROOMS 5

#define MAX_WS_CLIENTS 5

#define SLEEP_TIME_MS 200
#define STACKSIZE 1024
#define PRIORITY_7 7

#define MAX_SCHEDULES_PER_ROOM 4

#define MAX_SCHEDULES 15

#define UTC_PLUS_2 (2 * 3600) // UTC+2

#ifdef DEBUG_MODE
#define LOG_LEVEL LOG_LEVEL_DBG
#define LOGIN   \// To be removed after testing 
#else
#define LOG_LEVEL LOG_LEVEL_INF
#define LOGIN
#endif
/*
LOG_LEVEL_DBG - 4
LOG_LEVEL_ERR - 1
LOG_LEVEL_INF - 3
LOG_LEVEL_NONE - 0
LOG_LEVEL_WRN - 2
*/

#define CONTROLL_BOILER

#endif
```

## include/utilities.h
```c
#ifndef UTILITIES_H
#define UTILITIES_H

#include <stdint.h>
#include <string.h>

static int base64_decode(const char *src, unsigned char *dst, size_t dst_len, size_t *out_len)
{
    static const unsigned char base64_table[256] = {
        ['A'] = 0, ['B'] = 1, ['C'] = 2, ['D'] = 3, ['E'] = 4, ['F'] = 5, ['G'] = 6, ['H'] = 7,
        ['I'] = 8, ['J'] = 9, ['K'] = 10, ['L'] = 11, ['M'] = 12, ['N'] = 13, ['O'] = 14, ['P'] = 15,
        ['Q'] = 16, ['R'] = 17, ['S'] = 18, ['T'] = 19, ['U'] = 20, ['V'] = 21, ['W'] = 22, ['X'] = 23,
        ['Y'] = 24, ['Z'] = 25, ['a'] = 26, ['b'] = 27, ['c'] = 28, ['d'] = 29, ['e'] = 30, ['f'] = 31,
        ['g'] = 32, ['h'] = 33, ['i'] = 34, ['j'] = 35, ['k'] = 36, ['l'] = 37, ['m'] = 38, ['n'] = 39,
        ['o'] = 40, ['p'] = 41, ['q'] = 42, ['r'] = 43, ['s'] = 44, ['t'] = 45, ['u'] = 46, ['v'] = 47,
        ['w'] = 48, ['x'] = 49, ['y'] = 50, ['z'] = 51, ['0'] = 52, ['1'] = 53, ['2'] = 54, ['3'] = 55,
        ['4'] = 56, ['5'] = 57, ['6'] = 58, ['7'] = 59, ['8'] = 60, ['9'] = 61, ['+'] = 62, ['/'] = 63,
        ['='] = 0
    };

    size_t i = 0, j = 0;
    size_t len = strlen(src);

    while (i < len && j < dst_len - 1) {
        uint32_t sextet_a = src[i] == '=' ? 0 & i++ : base64_table[(unsigned char)src[i++]];
        uint32_t sextet_b = src[i] == '=' ? 0 & i++ : base64_table[(unsigned char)src[i++]];
        uint32_t sextet_c = src[i] == '=' ? 0 & i++ : base64_table[(unsigned char)src[i++]];
        uint32_t sextet_d = src[i] == '=' ? 0 & i++ : base64_table[(unsigned char)src[i++]];

        uint32_t triple = (sextet_a << 18) + (sextet_b << 12) + (sextet_c << 6) + sextet_d;

        if (j < dst_len) dst[j++] = (triple >> 16) & 0xFF;
        if (j < dst_len) dst[j++] = (triple >> 8) & 0xFF;
        if (j < dst_len) dst[j++] = triple & 0xFF;
    }

    *out_len = j;
    return 0;
}

#endif
```

## src/Web.c
```c
#include <zephyr/kernel.h>
#include <zephyr/net/http/server.h>
#include <zephyr/net/http/service.h>
#include <zephyr/logging/log.h>
#include <zephyr/data/json.h>
#include <zephyr/device.h>
#include <zephyr/drivers/gpio.h>
#include <zephyr/net/websocket.h>
#include <zephyr/sys/time_units.h>
#include <zephyr/net/sntp.h>
#include <zephyr/net/socket.h>
#include <zephyr/drivers/rtc.h>

#include "Room.h"
#include "config.h"
#include "Schedule.h"
#include "utilities.h"

LOG_MODULE_REGISTER(web_server, LOG_LEVEL_DBG);
static uint16_t ui_port = 80;

static const uint8_t index_html[] = {
#include "index.html.gz.inc"
};

bool check_auth(const struct http_request_ctx *request_ctx)
{
    const char *auth_header = NULL;

    // Search for Authorization header
    for (size_t i = 0; i < request_ctx->header_count; i++) {
        if (strcmp(request_ctx->headers[i].name, "Authorization") == 0) {
            auth_header = request_ctx->headers[i].value;
            break;
        }
    }

    if (!auth_header) {
        return false;
    }

    const char *encoded = auth_header + 6;

    unsigned char decoded[20];
    size_t decoded_len;

    int ret = base64_decode(encoded, decoded, sizeof(decoded), &decoded_len);

    if (ret != 0) {
        return false;
    }

    decoded[decoded_len] = '\0';

    return (strcmp((char *)decoded, "parola") == 0);
}
/* JSON commands definition */
struct led_command {
	int led_num;
	bool led_val;
};
static const struct json_obj_descr led_command_descr[] = {
	JSON_OBJ_DESCR_PRIM(struct led_command, led_num, JSON_TOK_NUMBER),
	JSON_OBJ_DESCR_PRIM(struct led_command, led_val, JSON_TOK_TRUE),
};

struct room_light_command {
	int room_id;
	int light_value;
};
static const struct json_obj_descr room_light_command_descr[] = {
	JSON_OBJ_DESCR_PRIM(struct room_light_command, room_id, JSON_TOK_NUMBER),
	JSON_OBJ_DESCR_PRIM(struct room_light_command, light_value, JSON_TOK_NUMBER),
};

// JSON commands for temperature and humidity only for reading
struct room_temp_read_command {
	int room_id;
	int temp_value;
	int hum_value;
};

static const struct json_obj_descr room_temp_command_descr[] = {
	JSON_OBJ_DESCR_PRIM(struct room_temp_read_command, room_id, JSON_TOK_NUMBER),
	JSON_OBJ_DESCR_PRIM(struct room_temp_read_command, temp_value, JSON_TOK_NUMBER),
	JSON_OBJ_DESCR_PRIM(struct room_temp_read_command, hum_value, JSON_TOK_NUMBER),
};

// JSON commands for temperature setting
struct room_temp_set_command {
	int room_id;
	int setpoint_temp_value;
};
static const struct json_obj_descr room_temp_set_command_descr[] = {
	JSON_OBJ_DESCR_PRIM(struct room_temp_set_command, room_id, JSON_TOK_NUMBER),
	JSON_OBJ_DESCR_PRIM(struct room_temp_set_command, setpoint_temp_value, JSON_TOK_NUMBER),
};

struct room_temp_heat_relay_command {
	int room_id;
	bool heat_relay_state;
};

static const struct json_obj_descr room_temp_heat_relay_command_descr[] = {
	JSON_OBJ_DESCR_PRIM(struct room_temp_heat_relay_command, room_id, JSON_TOK_NUMBER),
	JSON_OBJ_DESCR_PRIM(struct room_temp_heat_relay_command, heat_relay_state, JSON_TOK_TRUE),
};

struct TempSchedData {
	int room_id;
	int time;
    int temperature;
};

static const struct json_obj_descr temp_sched_command_descr[] = {
	JSON_OBJ_DESCR_PRIM(struct TempSchedData, room_id, JSON_TOK_NUMBER),
	JSON_OBJ_DESCR_PRIM(struct TempSchedData, time, JSON_TOK_NUMBER),
	JSON_OBJ_DESCR_PRIM(struct TempSchedData, temperature, JSON_TOK_NUMBER),
};

struct RoomData {
    uint32_t room_id;
    const char* room_name;
    uint32_t temp_sensor_value;
    uint32_t hum_sensor_value;
    uint32_t light_gpio_value;
    uint32_t desired_temperature;
    bool heat_relay_state;
	struct TempSchedData schedules[MAX_SCHEDULES_PER_ROOM];
	size_t num_sched;
};

struct RoomCollection {
    struct RoomData rooms[STRUCT_ROOM_COUNT];
    size_t num_rooms;
};

static const struct json_obj_descr room_command_descr[] = {
	JSON_OBJ_DESCR_PRIM(struct RoomData, room_id, JSON_TOK_NUMBER),
	JSON_OBJ_DESCR_PRIM(struct RoomData, room_name, JSON_TOK_STRING),
	JSON_OBJ_DESCR_PRIM(struct RoomData, temp_sensor_value, JSON_TOK_NUMBER),
	JSON_OBJ_DESCR_PRIM(struct RoomData, hum_sensor_value, JSON_TOK_NUMBER),
	JSON_OBJ_DESCR_PRIM(struct RoomData, light_gpio_value, JSON_TOK_NUMBER),
	JSON_OBJ_DESCR_PRIM(struct RoomData, desired_temperature, JSON_TOK_NUMBER),
	JSON_OBJ_DESCR_PRIM(struct RoomData, heat_relay_state, JSON_TOK_TRUE),
	JSON_OBJ_DESCR_OBJ_ARRAY(struct RoomData, schedules, MAX_SCHEDULES_PER_ROOM, 
                             num_sched, temp_sched_command_descr, ARRAY_SIZE(temp_sched_command_descr)),

};
static const struct json_obj_descr room_array_descr[] = {
    JSON_OBJ_DESCR_OBJ_ARRAY(struct RoomCollection, rooms, STRUCT_ROOM_COUNT, 
                             num_rooms, room_command_descr, ARRAY_SIZE(room_command_descr)),
};

struct room_schedule_command {
	int room_id;
	int setpoint_temp_value;
	int hour;
	int min;
	bool isAdd;
};

static const struct json_obj_descr room_schedule_command_descr[] = {
	JSON_OBJ_DESCR_PRIM(struct room_schedule_command, room_id, JSON_TOK_NUMBER),
	JSON_OBJ_DESCR_PRIM(struct room_schedule_command, setpoint_temp_value, JSON_TOK_NUMBER),
	JSON_OBJ_DESCR_PRIM(struct room_schedule_command, hour, JSON_TOK_NUMBER),
	JSON_OBJ_DESCR_PRIM(struct room_schedule_command, min, JSON_TOK_NUMBER),
	JSON_OBJ_DESCR_PRIM(struct room_schedule_command, isAdd, JSON_TOK_TRUE),
};

/* End JOSN conf */

static void http_response(struct http_response_ctx *response_ctx, uint16_t status_code,
		   const void *data, size_t data_len,
		   bool final_chunk)
{
	response_ctx->status = status_code;
	response_ctx->body = data;
	response_ctx->body_len = data_len;
	response_ctx->final_chunk = final_chunk;
}

/* Polymorphic function pointer for POST parser functions */
typedef bool (*post_parser_fn)(uint8_t *buf, size_t len);
struct post_state {
	uint8_t *buf;
	size_t cursor;
	uint16_t max_size;
	post_parser_fn parser;
};

static bool parse_schedule_post(uint8_t *buf, size_t len)
{
	int ret;
	struct room_schedule_command cmd;
	const int expected_return_code = BIT_MASK(ARRAY_SIZE(room_schedule_command_descr));

	buf[len] = '\0';
	ret = json_obj_parse(buf, len, room_schedule_command_descr, ARRAY_SIZE(room_schedule_command_descr), &cmd);
	if (ret != expected_return_code) {
		LOG_WRN("Failed to fully parse JSON payload, ret=%d", ret);
		return false;
	}

	LOG_INF("POST request schedule Room %d tmp %dC to %d:%d %s",
		cmd.room_id,
		cmd.setpoint_temp_value,
		cmd.hour,
		cmd.min,
		cmd.isAdd ? "Add" : "Remove");
	struct rtc_time zephyr_rtc_time;
	zephyr_rtc_time.tm_sec  = 0;
    zephyr_rtc_time.tm_min  = cmd.min;
    zephyr_rtc_time.tm_hour = cmd.hour;
	struct Schedule schedule = {
    	.parent_room = get_room_by_id(cmd.room_id),
    	.time = to_seconds_today(zephyr_rtc_time),
		.value = cmd.setpoint_temp_value,
		.type = SETPOINT_SCH,
	};
	LOG_INF("WEB time is %d", schedule.time);
	if (cmd.isAdd) {
		addNewSchedule(schedule);
	} else {
		removeSchedule(schedule);
	}

	return true;
}

static bool parse_led_post(uint8_t *buf, size_t len)
{
	int ret;
	struct led_command cmd;
	const int expected_return_code = BIT_MASK(ARRAY_SIZE(led_command_descr));

	buf[len] = '\0';
	ret = json_obj_parse(buf, len, led_command_descr, ARRAY_SIZE(led_command_descr), &cmd);
	if (ret != expected_return_code) {
		LOG_WRN("Failed to fully parse JSON payload, ret=%d", ret);
		return false;
	}

	LOG_INF("POST request setting LED %d to state %d", cmd.led_num, cmd.led_val);

    const struct gpio_dt_spec *gpio = get_led_by_id(cmd.led_num);

    gpio_pin_set(gpio->port, gpio->pin, cmd.led_val);
	return true;
}

static bool parse_room_light_post(uint8_t *buf, size_t len)
{
	int ret;
	struct room_light_command cmd;
	const int expected_return_code = BIT_MASK(ARRAY_SIZE(room_light_command_descr));

	buf[len] = '\0';
	ret = json_obj_parse(buf, len, room_light_command_descr, ARRAY_SIZE(room_light_command_descr), &cmd);
	if (ret != expected_return_code) {
		LOG_WRN("Failed to fully parse JSON payload, ret=%d", ret);
		return false;
	}

	LOG_INF("POST request setting LIGHT %d to state %d", cmd.room_id, cmd.light_value);

    struct Room *room = get_room_by_id(cmd.room_id);
    uint32_t new_state = cmd.light_value ? room->light_pwm->period * 90 /100 : 0;
	k_mutex_lock(&room->lock, K_FOREVER);
	process_light_control(room, new_state);
	k_mutex_unlock(&room->lock);
	return true;
}

static bool parse_temp_post(uint8_t *buf, size_t len)
{
	int ret;
	struct room_temp_set_command cmd;
	const int expected_return_code = BIT_MASK(ARRAY_SIZE(room_temp_set_command_descr));

	buf[len] = '\0';
	ret = json_obj_parse(buf, len, room_temp_set_command_descr, ARRAY_SIZE(room_temp_set_command_descr), &cmd);
	if (ret != expected_return_code) {
		LOG_WRN("Failed to fully parse JSON payload, ret=%d", ret);
		return false;
	}

	LOG_INF("POST request received ROOM %d SETPOINT value %d", cmd.room_id, cmd.setpoint_temp_value);

	struct Room *room = get_room_by_id(cmd.room_id);
	if (room != NULL) {
		register_new_event(room, cmd.setpoint_temp_value, SETPOINT_EV, true);
		k_mutex_lock(&room->lock, K_FOREVER);
		room->desired_temperature = cmd.setpoint_temp_value;
		// After setting new desired temperature, process control logic
		process_temperature_control(room);
		k_mutex_unlock(&room->lock);
		return true;
	}
	return false;
}

static struct post_state led_post_state = {
	.buf = NULL,
	.cursor = 0,
	.max_size = 64,
	.parser = parse_led_post,
};

static struct post_state room_light_post_state = {
	.buf = NULL,
	.cursor = 0,
	.max_size = 64,
	.parser = parse_room_light_post,
};

static struct post_state room_temp_post_state = {
	.buf = NULL,
	.cursor = 0,
	.max_size = 128,
	.parser = parse_temp_post,
};

static struct post_state room_schedule_post_state = {
	.buf = NULL,
	.cursor = 0,
	.max_size = 128,
	.parser = parse_schedule_post,
};


static int post_handler(struct http_client_ctx *client, enum http_data_status status,
		       const struct http_request_ctx *request_ctx,
		       struct http_response_ctx *response_ctx, void *user_data)
{
#ifdef LOGIN
    if (!check_auth(request_ctx)) {
		http_response(response_ctx, 401, NULL, 0, true);
        return 0;
    }
#endif

	struct post_state *state = user_data;

	LOG_DBG("POST handler status %d, size %zu", status, request_ctx->data_len);

	if (status == HTTP_SERVER_DATA_ABORTED) {
		if (state->buf) {
			k_free(state->buf);
			state->buf = NULL;
		}
		state->cursor = 0;
		return 0;
	}

	if (state->buf == NULL) {
        state->buf = (uint8_t *)k_malloc(state->max_size + 1);
        if (!state->buf) {
            LOG_ERR("Out of memory for POST buffer");
            return -ENOMEM;
        }
        state->cursor = 0;
    }

	if (request_ctx->data_len + state->cursor > state->max_size) {
		state->cursor = 0;
		LOG_ERR("Size of the message is to long, please increase the buffer size");
		k_free(state->buf);
		return -ENOMEM;
	}

	/* Copy payload to our buffer. Note that even for a small payload, it may arrive split into
	 * chunks (e.g. if the header size was such that the whole HTTP request exceeds the size of
	 * the client buffer).
	 */
	memcpy(state->buf + state->cursor, request_ctx->data, request_ctx->data_len);
	state->cursor += request_ctx->data_len;

	if (status == HTTP_SERVER_DATA_FINAL) {
		if (state->parser(state->buf, state->cursor)) {
			http_response(response_ctx, 200, NULL, 0, true);
		} else {
			http_response(response_ctx, 400, NULL, 0, true);
		}
		k_free(state->buf);
		state->buf = NULL;
		state->cursor = 0;
	}

	return 0;
}
/* End Poly. POST */

/* Handler for GET */
static int rooms_get_handler(struct http_client_ctx *client, enum http_data_status status,
		       const struct http_request_ctx *request_ctx,
		       struct http_response_ctx *response_ctx, void *user_data)
{
#ifdef LOGIN
    if (!check_auth(request_ctx)) {
		http_response(response_ctx, 401, NULL, 0, true);
        return 0;
    }
#endif

	if (status == HTTP_SERVER_DATA_FINAL) {
		static char json_buf[512];

		struct Room **hardware_rooms = get_all_rooms();
		struct RoomCollection collection;
		collection.num_rooms = STRUCT_ROOM_COUNT;
		for (size_t i = 0; i < STRUCT_ROOM_COUNT; i++) {
			k_mutex_lock(&hardware_rooms[i]->lock, K_FOREVER);
			collection.rooms[i].room_id = hardware_rooms[i]->room_id;
			collection.rooms[i].room_name = hardware_rooms[i]->room_name;
			collection.rooms[i].temp_sensor_value = hardware_rooms[i]->temp_sensor_value;
			collection.rooms[i].hum_sensor_value = hardware_rooms[i]->hum_sensor_value;
			collection.rooms[i].light_gpio_value = hardware_rooms[i]->light_gpio_value;
			collection.rooms[i].desired_temperature = hardware_rooms[i]->desired_temperature;
			collection.rooms[i].heat_relay_state = hardware_rooms[i]->heat_relay_state;
			collection.rooms[i].num_sched = hardware_rooms[i]->no_sched;

			for (size_t j = 0; j < hardware_rooms[i]->no_sched; j++) {
				collection.rooms[i].schedules[j].time = hardware_rooms[i]->list_of_schedules[j].time;
				collection.rooms[i].schedules[j].temperature = hardware_rooms[i]->list_of_schedules[j].value;
			}
			k_mutex_unlock(&hardware_rooms[i]->lock);
		}
		
		int ret = json_arr_encode_buf(
			room_array_descr,
			&collection,
			json_buf,
			sizeof(json_buf)
		);

		if (ret < 0) {
			LOG_ERR("Failed to encode JSON: %d", ret);
			http_response(response_ctx, 500, NULL, 0, true);
			return -1;
		}

		size_t json_len = strlen(json_buf);
		http_response(response_ctx, 200, json_buf, json_len, true);
	}
	return 0;
}

static int up_handler(struct http_client_ctx *client, enum http_data_status status,
		       const struct http_request_ctx *request_ctx,
		       struct http_response_ctx *response_ctx, void *user_data)
{
	http_response(response_ctx, 200, NULL, 0, true);
	return 0;
}

/* HTTP resource definitions */
static struct http_resource_detail_static index_detail = {
    .common = {
        .type = HTTP_RESOURCE_TYPE_STATIC,
        .bitmask_of_supported_http_methods = BIT(HTTP_GET),
        .content_encoding = "gzip",
        .content_type = "text/html",
    },
    .static_data = index_html,
    .static_data_len = sizeof(index_html),
};

static struct http_resource_detail_dynamic led_resource_detail = {
	.common = {
			.type = HTTP_RESOURCE_TYPE_DYNAMIC,
			.bitmask_of_supported_http_methods = BIT(HTTP_POST),
		},
	.cb = post_handler,
	.user_data = &led_post_state,
};

static struct http_resource_detail_dynamic room_light_resource_detail = {
	.common = {
			.type = HTTP_RESOURCE_TYPE_DYNAMIC,
			.bitmask_of_supported_http_methods = BIT(HTTP_POST),
		},
	.cb = post_handler,
	.user_data = &room_light_post_state,
};

static struct http_resource_detail_dynamic room_temp_resource_detail = {
	.common = {
			.type = HTTP_RESOURCE_TYPE_DYNAMIC,
			.bitmask_of_supported_http_methods = BIT(HTTP_POST),
		},
	.cb = post_handler,
	.user_data = &room_temp_post_state,
};

static struct http_resource_detail_dynamic room_schedule_resource_detail = {
	.common = {
			.type = HTTP_RESOURCE_TYPE_DYNAMIC,
			.bitmask_of_supported_http_methods = BIT(HTTP_POST),
		},
	.cb = post_handler,
	.user_data = &room_schedule_post_state,
};

static struct http_resource_detail_dynamic room_command_detail = {
	.common = {
			.type = HTTP_RESOURCE_TYPE_DYNAMIC,
			.bitmask_of_supported_http_methods = BIT(HTTP_GET),
		},
	.cb = rooms_get_handler,
	.user_data = NULL,
};

static struct http_resource_detail_dynamic is_up_detail = {
	.common = {
			.type = HTTP_RESOURCE_TYPE_DYNAMIC,
			.bitmask_of_supported_http_methods = BIT(HTTP_GET),
		},
	.cb = up_handler,
	.user_data = NULL,
};
/* END HTTP resource definitions */

/* WEB sockets */
static int ws_clients[MAX_WS_CLIENTS] = {0};
static uint8_t number_of_clients_connected = 0;
static uint8_t ws_buffer[256];
static uint8_t ws_tx_buffer[256];

int ws_setup(int ws_socket, struct http_request_ctx *req_ctx, void *user_data)
{
    uint64_t start_time = k_uptime_get();
    for (int i = 0; i < MAX_WS_CLIENTS; i++) {
        if (ws_clients[i] <= 0) {
            ws_clients[i] = ws_socket;
            LOG_INF("WebSocket client connected (slot %d)", i);
            number_of_clients_connected++;
            uint64_t end_time = k_uptime_get();
            LOG_DBG("WebSocket setup time: %llu ms", end_time - start_time);
            return 0;
        }
    }
    LOG_ERR("No free WebSocket slots");
    uint64_t end_time = k_uptime_get();
    LOG_DBG("WebSocket setup time (failure): %llu ms", end_time - start_time);
    return -ENOMEM;
}


// This thread will be responsible for sending data to all connected websocket clients
// it will not handle receiving data from clients
void ws_thread(void *arg1, void *arg2, void *arg3)
{
    (void)arg1; (void)arg2; (void)arg3;

    while (1) {

        // Process all pending web events
        struct WebEvent *new_web_event = k_fifo_get(&web_events_fifo, K_NO_WAIT);
        if (new_web_event == NULL) {
            k_msleep(200);
            continue;
        }

        // Skip event processing if no clients are connected
        if (number_of_clients_connected == 0) {
            k_free(new_web_event);
            k_msleep(200);
            continue;
        }

        LOG_DBG("Sending data");
		// Dont't acces data.value without verifing, can lead to ERRORS
		// LOG_DBG("Web event: room %d, type %d, value %d",
		// 		new_web_event->room_id,
		// 		new_web_event->value_type,
		// 		new_web_event->data.value);

		int ret = 0;
		switch (new_web_event->value_type) {
			case LIGHT_EV: {
				struct room_light_command room_light_data;
				room_light_data.room_id = new_web_event->room_id;
				room_light_data.light_value = new_web_event->data.value;

				ret = json_obj_encode_buf(room_light_command_descr,
											ARRAY_SIZE(room_light_command_descr),
											&room_light_data,
											ws_tx_buffer,
											sizeof(ws_tx_buffer));
				break;
			}
			case HEAT_EV:
			case HUM_EV: {
				struct Room *room = get_room_by_id(new_web_event->room_id);
				struct room_temp_read_command room_data;
				room_data.room_id = new_web_event->room_id;
				k_mutex_lock(&room->lock, K_FOREVER);
				room_data.temp_value = (new_web_event->value_type == HEAT_EV) ? new_web_event->data.value : (room ? room->temp_sensor_value : 0);
    			room_data.hum_value = (new_web_event->value_type == HUM_EV) ? new_web_event->data.value : (room ? room->hum_sensor_value : 0);
				k_mutex_unlock(&room->lock);
				ret = json_obj_encode_buf(room_temp_command_descr,
												ARRAY_SIZE(room_temp_command_descr),
												&room_data,
												ws_tx_buffer,
												sizeof(ws_tx_buffer));
				break;
			}
			case SETPOINT_EV: {
				struct room_temp_set_command room_setpoint_data;
				room_setpoint_data.room_id = new_web_event->room_id;
				room_setpoint_data.setpoint_temp_value = new_web_event->data.value;

				ret = json_obj_encode_buf(room_temp_set_command_descr,
											ARRAY_SIZE(room_temp_set_command_descr),
											&room_setpoint_data,
											ws_tx_buffer,
											sizeof(ws_tx_buffer));
				break;
			}
			case HEAT_RELAY_EV:
				struct room_temp_heat_relay_command room_heat_relay_data;
				room_heat_relay_data.room_id = new_web_event->room_id;
				room_heat_relay_data.heat_relay_state = new_web_event->data.value ? true : false;
				ret = json_obj_encode_buf(room_temp_heat_relay_command_descr,
											ARRAY_SIZE(room_temp_heat_relay_command_descr),
											&room_heat_relay_data,
											ws_tx_buffer,
											sizeof(ws_tx_buffer));
				break;
			case SCHEDULE_ADDED_EV:
				struct TempSchedData room_temp_sched_data;
				room_temp_sched_data.room_id = new_web_event->room_id;
				room_temp_sched_data.time = new_web_event->data.sched->time;
				room_temp_sched_data.temperature = new_web_event->data.sched->value;
				ret = json_obj_encode_buf(temp_sched_command_descr,
											ARRAY_SIZE(temp_sched_command_descr),
											&room_temp_sched_data,
											ws_tx_buffer,
											sizeof(ws_tx_buffer));
				break;
			default:
				LOG_WRN("Unknown web event type: %d", new_web_event->value_type);
				break;
		}
		k_free(new_web_event);

		if (ret < 0) {
			LOG_ERR("Encoding failed: %d", ret);
			continue;
		} else if (ret > 0) {
			LOG_DBG("Encoded successfully!");
			LOG_DBG("String: %s", ws_tx_buffer);
			LOG_HEXDUMP_DBG(ws_tx_buffer, strlen(ws_tx_buffer), "JSON raw");
		}

		// Send data to all connected clients
		for (int i = 0; i < MAX_WS_CLIENTS; i++) {
			if (ws_clients[i] == 0) continue;

			int res = websocket_send_msg(ws_clients[i], 
										ws_tx_buffer, 
										strlen(ws_tx_buffer),
										WEBSOCKET_OPCODE_DATA_TEXT,
										false,
										true,
										SYS_FOREVER_MS);

			if (res < 0) {
				LOG_INF("Client %d disconnected, freeing slot", i);
				websocket_unregister(ws_clients[i]);
				ws_clients[i] = 0;
				number_of_clients_connected--;
			}
		}

        k_msleep(200);
    }
}

K_THREAD_STACK_DEFINE(ws_stack, 4096);
static struct k_thread ws_tid;

static int web_init(void)
{
    k_thread_create(&ws_tid, ws_stack, K_THREAD_STACK_SIZEOF(ws_stack),
                    ws_thread, NULL, NULL, NULL,
                    K_PRIO_PREEMPT(5), 0, K_NO_WAIT);
    return 0;
}
struct http_resource_detail_websocket ws_resource_detail = {
	.common = {
			.type = HTTP_RESOURCE_TYPE_WEBSOCKET,
			.bitmask_of_supported_http_methods = BIT(HTTP_GET),
		},
	.cb = ws_setup,
	.data_buffer = ws_buffer,
	.data_buffer_len = sizeof(ws_buffer),
	.user_data = NULL,
};

/* END WEB sockets*/

HTTP_SERVICE_DEFINE(test_http_service, NULL, &ui_port, 4, 10, NULL, NULL, NULL);

HTTP_RESOURCE_DEFINE(index_res, test_http_service, "/", &index_detail);

HTTP_RESOURCE_DEFINE(led_res, test_http_service, "/api/v1/led", &led_resource_detail);

HTTP_RESOURCE_DEFINE(light_res, test_http_service, "/api/v1/light", &room_light_resource_detail);

HTTP_RESOURCE_DEFINE(temp_res, test_http_service, "/api/v1/temp", &room_temp_resource_detail);

HTTP_RESOURCE_DEFINE(sched_res, test_http_service, "/api/v1/schedule", &room_schedule_resource_detail);

HTTP_RESOURCE_DEFINE(room_res, test_http_service, "/api/v1/rooms", &room_command_detail);

HTTP_RESOURCE_DEFINE(up_res, test_http_service, "/api/v1/is_up", &is_up_detail);

HTTP_RESOURCE_DEFINE(ws_res, test_http_service, "/ws", &ws_resource_detail);

SYS_INIT(web_init, APPLICATION, 0);
    
```
